## main/Kconfig.projbuild
```kconfig
# BYUI eBadge Project Configuration

menu "Project Configuration"

    config WIFI_SSID
        string "Wi-Fi SSID"
        default "BYUI_Visitor"
        help
            SSID of the Wi-Fi network to connect to.

    config WIFI_PASSWORD
        string "Wi-Fi Password (leave empty for open network)"
        default ""
        help
            WPA/WPA2 password. Leave blank for open networks.

    config WIFI_MAXIMUM_RETRY
        int "Maximum Wi-Fi retry attempts"
        default 5
        help
            Number of times to retry connecting before giving up.

endmenu
```

## sdkconfig.defaults
```kconfig
# BYUI eBadge V3.0 — Default Configuration
# Target: ESP32-S3 (QFN56) — 4 MB embedded flash (XMC), 2 MB octal PSRAM
#
# These settings apply when sdkconfig does not exist.
# Run `idf.py menuconfig` to customise further.

# ─── Target ──────────────────────────────────────────────────────
CONFIG_IDF_TARGET="esp32s3"

# ─── Flash ───────────────────────────────────────────────────────
CONFIG_ESPTOOLPY_FLASHSIZE_4MB=y
CONFIG_ESPTOOLPY_FLASHSIZE="4MB"
CONFIG_ESPTOOLPY_FLASHMODE_QIO=y
CONFIG_ESPTOOLPY_FLASHFREQ_80M=y

# ─── Partition table ─────────────────────────────────────────────
CONFIG_PARTITION_TABLE_CUSTOM=y
CONFIG_PARTITION_TABLE_CUSTOM_FILENAME="partitions.csv"
CONFIG_PARTITION_TABLE_FILENAME="partitions.csv"

# ─── PSRAM ───────────────────────────────────────────────────────
# N8 module has no PSRAM — SPIRAM probe must be disabled.
# With CONFIG_SPIRAM=y the MSPI init runs before app_main and leaves
# the button GPIO pads (GPIO14-18, GPIO38) held at 0V.
# CONFIG_SPIRAM is not set

# ─── Console via UART0 → CP2102N (COM8) ──────────────────────────
CONFIG_ESP_CONSOLE_UART_DEFAULT=y
CONFIG_ESP_CONSOLE_SECONDARY_NONE=y

# ─── Compiler ────────────────────────────────────────────────────
CONFIG_COMPILER_OPTIMIZATION_SIZE=y

# ─── System ──────────────────────────────────────────────────────
CONFIG_ESP_MAIN_TASK_STACK_SIZE=8192
CONFIG_ESP_TASK_WDT_TIMEOUT_S=10
CONFIG_FREERTOS_HZ=1000

# ─── Logging ─────────────────────────────────────────────────────
CONFIG_LOG_DEFAULT_LEVEL_INFO=y
CONFIG_BOOTLOADER_LOG_LEVEL_INFO=y

# ─── Wi-Fi ───────────────────────────────────────────────────────
CONFIG_ESP_WIFI_STATIC_RX_BUFFER_NUM=10
CONFIG_ESP_WIFI_DYNAMIC_RX_BUFFER_NUM=32
CONFIG_ESP_WIFI_DYNAMIC_TX_BUFFER_NUM=32

# ─── LWIP ────────────────────────────────────────────────────────
CONFIG_LWIP_MAX_SOCKETS=10

# ─── HTTP / TLS ──────────────────────────────────────────────────
CONFIG_ESP_HTTP_CLIENT_ENABLE_HTTPS=y
CONFIG_MBEDTLS_CERTIFICATE_BUNDLE=y
CONFIG_MBEDTLS_CERTIFICATE_BUNDLE_DEFAULT_FULL=y

# ─── HTTP Server ─────────────────────────────────────────────────
# Real browser requests carry Accept, Cookie, and other headers that
# easily exceed the default 512 B limit, producing "Header fields too long".
CONFIG_HTTPD_MAX_REQ_HDR_LEN=2048
```
