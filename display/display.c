/**
 * @file display.c
 * @brief ILI9341 TFT driver — SPI2, landscape 320×240.
 *
 * Includes a built-in public-domain 8×8 bitmap font covering the full
 * printable ASCII range (0x20–0x7F).  Each font byte is one pixel row;
 * within each byte bit-0 is the leftmost pixel (LSB-left convention).
 *
 * Pin assignments from HARDWARE.md (BYUI eBadge V3.0):
 *   CS=9  DC=13  RST=48  CLK=12  MOSI=11  MISO=10
 */

#include "display.h"
#include "qrcode.h"

#include <string.h>
#include "freertos/FreeRTOS.h"
#include "freertos/task.h"
#include "driver/spi_master.h"
#include "driver/gpio.h"
#include "esp_log.h"

/* ── Pin definitions ─────────────────────────────────────────────── */
#define DISP_PIN_CS    9
#define DISP_PIN_DC    13
#define DISP_PIN_RST   48
#define DISP_PIN_CLK   12
#define DISP_PIN_MOSI  11
#define DISP_PIN_MISO  10
#define DISP_SPI_HOST  SPI2_HOST
#define DISP_SPI_FREQ  SPI_MASTER_FREQ_40M

static const char *TAG = "display";
static spi_device_handle_t s_spi;

/* ═══════════════════════════════════════════════════════════════════
 * 8×8 public-domain bitmap font — printable ASCII 0x20–0x7F
 * Encoding: byte[0] = top row … byte[7] = bottom row; bit 0 = left.
 * Source: font8x8_basic (https://github.com/dhepper/font8x8) — PD
 * ═══════════════════════════════════════════════════════════════════ */
static const uint8_t s_font8x8[96][8] = {
    {0x00,0x00,0x00,0x00,0x00,0x00,0x00,0x00}, /* 0x20 ' '  */
    {0x18,0x3C,0x3C,0x18,0x18,0x00,0x18,0x00}, /* 0x21 '!'  */
    {0x36,0x36,0x00,0x00,0x00,0x00,0x00,0x00}, /* 0x22 '"'  */
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    {0x00,0x00,0x00,0x00,0x00,0x00,0x00,0x00}, /* 0x7F DEL  */
};

/* ═══════════════════════════════════════════════════════════════════
 * 8×8 sans-serif bitmap font — printable ASCII 0x20–0x7F
 * Clean strokes, no serifs, open apertures.
 * Encoding: byte[0]=top row … byte[7]=bottom row; bit 0 = leftmost column.
 * ═══════════════════════════════════════════════════════════════════ */
static const uint8_t s_font8x8_sans[96][8] = {
    {0x00,0x00,0x00,0x00,0x00,0x00,0x00,0x00}, /* 0x20 ' '  */
    {0x18,0x18,0x18,0x18,0x18,0x00,0x18,0x00}, /* 0x21 '!'  */
    {0x6C,0x6C,0x00,0x00,0x00,0x00,0x00,0x00}, /* 0x22 '"'  */
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    {0x00,0x00,0x00,0x00,0x00,0x00,0x00,0x00}, /* 0x7F DEL  */
};

/* DC-pin callback: t->user == 0 → command (DC low); 1 → data (DC high). */
static void IRAM_ATTR spi_pre_transfer_cb(spi_transaction_t *t)
{
    gpio_set_level(DISP_PIN_DC, (int)(intptr_t)t->user);
}

static void disp_cmd(uint8_t cmd)
{
    spi_transaction_t t = {
        .length  = 8,
        .tx_data = {cmd},
        .flags   = SPI_TRANS_USE_TXDATA,
        .user    = (void *)0,
    };
    ESP_ERROR_CHECK(spi_device_polling_transmit(s_spi, &t));
}

static void disp_data(const uint8_t *data, int len)
{
    if (len == 0) return;
    spi_transaction_t t = {
        .length    = (size_t)len * 8,
        .tx_buffer = data,
        .user      = (void *)1,
    };
    ESP_ERROR_CHECK(spi_device_polling_transmit(s_spi, &t));
}

/* Set address window, then send RAMWR command so pixels can follow. */
static void set_window(uint16_t x0, uint16_t y0, uint16_t x1, uint16_t y1)
{
    uint8_t d[4];
    disp_cmd(0x2A);
    d[0]=x0>>8; d[1]=x0&0xFF; d[2]=x1>>8; d[3]=x1&0xFF;
    disp_data(d, 4);
    disp_cmd(0x2B);
    d[0]=y0>>8; d[1]=y0&0xFF; d[2]=y1>>8; d[3]=y1&0xFF;
    disp_data(d, 4);
    disp_cmd(0x2C);
}

/* Write a buffer of already-formatted pixel bytes into the current window. */
static void write_pixels(const uint8_t *buf, int nbytes)
{
    spi_transaction_t t = {
        .length    = (size_t)nbytes * 8,
        .tx_buffer = buf,
        .user      = (void *)1,
    };
    ESP_ERROR_CHECK(spi_device_polling_transmit(s_spi, &t));
}

/* Convert a host-order RGB565 value to the two bytes the ILI9341 expects
 * (big-endian: high byte first). */
static inline void pack_pixel(uint8_t *dst, uint16_t color)
{
    dst[0] = (uint8_t)(color >> 8);
    dst[1] = (uint8_t)(color & 0xFF);
}

/* ═══════════════════════════════════════════════════════════════════
 * ILI9341 initialisation
 * ═══════════════════════════════════════════════════════════════════ */

static void ili9341_hw_reset(void)
{
    gpio_set_level(DISP_PIN_RST, 0);
    vTaskDelay(pdMS_TO_TICKS(10));
    gpio_set_level(DISP_PIN_RST, 1);
    vTaskDelay(pdMS_TO_TICKS(120));
}

static void ili9341_init_regs(void)
{
    disp_cmd(0x01); vTaskDelay(pdMS_TO_TICKS(150)); /* software reset */
    disp_cmd(0xEF); disp_data((uint8_t[]){0x03,0x80,0x02}, 3);
    disp_cmd(0xCF); disp_data((uint8_t[]){0x00,0xC1,0x30}, 3);
    disp_cmd(0xED); disp_data((uint8_t[]){0x64,0x03,0x12,0x81}, 4);
    disp_cmd(0xE8); disp_data((uint8_t[]){0x85,0x00,0x78}, 3);
    disp_cmd(0xCB); disp_data((uint8_t[]){0x39,0x2C,0x00,0x34,0x02}, 5);
    disp_cmd(0xF7); disp_data((uint8_t[]){0x20}, 1);
    disp_cmd(0xEA); disp_data((uint8_t[]){0x00,0x00}, 2);
    disp_cmd(0xC0); disp_data((uint8_t[]){0x23}, 1);   /* power control 1 */
    disp_cmd(0xC1); disp_data((uint8_t[]){0x10}, 1);   /* power control 2 */
    disp_cmd(0xC5); disp_data((uint8_t[]){0x3E,0x28}, 2); /* VCOM */
    disp_cmd(0xC7); disp_data((uint8_t[]){0x86}, 1);
    disp_cmd(0x36); disp_data((uint8_t[]){0x40}, 1);   /* MADCTL — landscape (MX) */  
    disp_cmd(0x3A); disp_data((uint8_t[]){0x55}, 1);   /* 16-bit colour */
    disp_cmd(0xB1); disp_data((uint8_t[]){0x00,0x18}, 2); /* frame rate ~70 Hz */
    disp_cmd(0xB6); disp_data((uint8_t[]){0x08,0x82,0x27}, 3);
    disp_cmd(0xF2); disp_data((uint8_t[]){0x00}, 1);
    disp_cmd(0x26); disp_data((uint8_t[]){0x01}, 1);
    disp_cmd(0xE0); disp_data((uint8_t[]){0x0F,0x31,0x2B,0x0C,0x0E,0x08,
                                           0x4E,0xF1,0x37,0x07,0x10,0x03,
                                           0x0E,0x09,0x00}, 15);
    disp_cmd(0xE1); disp_data((uint8_t[]){0x00,0x0E,0x14,0x03,0x11,0x07,
                                           0x31,0xC1,0x48,0x08,0x0F,0x0C,
                                           0x31,0x36,0x0F}, 15);
    disp_cmd(0x11); vTaskDelay(pdMS_TO_TICKS(120)); /* sleep out */
    disp_cmd(0x21);                                  /* inversion on — panel default is inverted */
    disp_cmd(0x29);                                  /* display on */
}

static void spi_and_gpio_init(void)
{
    gpio_config_t io = {
        .pin_bit_mask = (1ULL << DISP_PIN_DC) | (1ULL << DISP_PIN_RST),
        .mode         = GPIO_MODE_OUTPUT,
    };
    ESP_ERROR_CHECK(gpio_config(&io));

    spi_bus_config_t bus = {
        .mosi_io_num     = DISP_PIN_MOSI,
        .miso_io_num     = DISP_PIN_MISO,
        .sclk_io_num     = DISP_PIN_CLK,
        .quadwp_io_num   = -1,
        .quadhd_io_num   = -1,
        .max_transfer_sz = DISPLAY_W * 2 + 8,
    };
    ESP_ERROR_CHECK(spi_bus_initialize(DISP_SPI_HOST, &bus, SPI_DMA_CH_AUTO));

    spi_device_interface_config_t dev = {
        .clock_speed_hz = DISP_SPI_FREQ,
        .mode           = 0,
        .spics_io_num   = DISP_PIN_CS,
        .queue_size     = 7,
        .pre_cb         = spi_pre_transfer_cb,
    };
    ESP_ERROR_CHECK(spi_bus_add_device(DISP_SPI_HOST, &dev, &s_spi));
}

/* ═══════════════════════════════════════════════════════════════════
 * Public API
 * ═══════════════════════════════════════════════════════════════════ */

void display_set_madctl(uint8_t madctl)
{
    disp_cmd(0x36);
    disp_data(&madctl, 1);
}

void display_init(void)
{
    ESP_LOGI(TAG, "Initialising SPI2 and ILI9341 (landscape 320×240)");
    spi_and_gpio_init();
    ili9341_hw_reset();
    ili9341_init_regs();
    ESP_LOGI(TAG, "Display ready");
}

void display_fill(uint16_t color)
{
    /* Build a one-row pixel buffer (320 pixels × 2 bytes). */
    static uint8_t row_buf[DISPLAY_W * 2];
    for (int i = 0; i < DISPLAY_W; i++) {
        pack_pixel(&row_buf[i * 2], color);
    }

    set_window(0, 0, DISPLAY_W - 1, DISPLAY_H - 1);
    for (int y = 0; y < DISPLAY_H; y++) {
        write_pixels(row_buf, DISPLAY_W * 2);
    }
}

void display_fill_rect(int x, int y, int w, int h, uint16_t color)
{
    /* Clamp to screen bounds. */
    if (x < 0)              { w += x; x = 0; }
    if (y < 0)              { h += y; y = 0; }
    if (x + w > DISPLAY_W)  w = DISPLAY_W - x;
    if (y + h > DISPLAY_H)  h = DISPLAY_H - y;
    if (w <= 0 || h <= 0)   return;

    static uint8_t row_buf[DISPLAY_W * 2];
    for (int i = 0; i < w; i++) pack_pixel(&row_buf[i * 2], color);

    set_window((uint16_t)x, (uint16_t)y,
               (uint16_t)(x + w - 1), (uint16_t)(y + h - 1));
    for (int row = 0; row < h; row++) write_pixels(row_buf, w * 2);
}

void display_draw_char(int x, int y, char c, uint16_t fg, uint16_t bg, int scale)
{
    if (c < 0x20 || c > 0x7F) c = '?';
    const uint8_t *glyph = s_font8x8[(uint8_t)(c - 0x20)];

    /* Two-byte packed colour values for the SPI buffer. */
    uint8_t fg_hi = (uint8_t)(fg >> 8), fg_lo = (uint8_t)(fg & 0xFF);
    uint8_t bg_hi = (uint8_t)(bg >> 8), bg_lo = (uint8_t)(bg & 0xFF);

    /* One scaled row: 8 font columns × scale pixels × 2 bytes each. */
    int row_bytes = DISPLAY_FONT_W * scale * 2;
    uint8_t row_buf[DISPLAY_FONT_W * 4 * 2]; /* scale up to 4 fits here */

    for (int fr = 0; fr < DISPLAY_FONT_H; fr++) {
        uint8_t bits = glyph[fr];

        /* Build the pixel run for this scaled row. */
        int bi = 0;
        for (int fc = 0; fc < DISPLAY_FONT_W; fc++) {
            bool lit = (bits >> fc) & 1; /* bit 0 = leftmost column */
            uint8_t hi = lit ? fg_hi : bg_hi;
            uint8_t lo = lit ? fg_lo : bg_lo;
            for (int sx = 0; sx < scale; sx++) {
                row_buf[bi++] = hi;
                row_buf[bi++] = lo;
            }
        }

        /* Write scale identical rows for vertical scaling. */
        for (int sy = 0; sy < scale; sy++) {
            int screen_y = y + fr * scale + sy;
            if (screen_y >= DISPLAY_H) return;
            int screen_x1 = x + DISPLAY_FONT_W * scale - 1;
            if (screen_x1 >= DISPLAY_W) screen_x1 = DISPLAY_W - 1;
            set_window((uint16_t)x, (uint16_t)screen_y,
                       (uint16_t)screen_x1, (uint16_t)screen_y);
            write_pixels(row_buf, row_bytes);
        }
    }
}

void display_draw_string(int x, int y, const char *str,
                         uint16_t fg, uint16_t bg, int scale)
{
    int cx = x;
    while (*str) {
        display_draw_char(cx, y, *str, fg, bg, scale);
        cx += DISPLAY_FONT_W * scale;
        str++;
    }
}

/* ── Internal: draw one char from an arbitrary 8×8 font table ───── */
static void draw_char_font(int x, int y, char c,
                           uint16_t fg, uint16_t bg, int scale,
                           const uint8_t font[96][8])
{
    if (c < 0x20 || c > 0x7F) c = '?';
    const uint8_t *glyph = font[(uint8_t)(c - 0x20)];

    uint8_t fg_hi = (uint8_t)(fg >> 8), fg_lo = (uint8_t)(fg & 0xFF);
    uint8_t bg_hi = (uint8_t)(bg >> 8), bg_lo = (uint8_t)(bg & 0xFF);

    int row_bytes = DISPLAY_FONT_W * scale * 2;
    uint8_t row_buf[DISPLAY_FONT_W * 4 * 2];

    for (int fr = 0; fr < DISPLAY_FONT_H; fr++) {
        uint8_t bits = glyph[fr];
        int bi = 0;
        for (int fc = 0; fc < DISPLAY_FONT_W; fc++) {
            bool lit = (bits >> fc) & 1;
            uint8_t hi = lit ? fg_hi : bg_hi;
            uint8_t lo = lit ? fg_lo : bg_lo;
            for (int sx = 0; sx < scale; sx++) {
                row_buf[bi++] = hi;
                row_buf[bi++] = lo;
            }
        }
        for (int sy = 0; sy < scale; sy++) {
            int screen_y = y + fr * scale + sy;
            if (screen_y >= DISPLAY_H) return;
            int screen_x1 = x + DISPLAY_FONT_W * scale - 1;
            if (screen_x1 >= DISPLAY_W) screen_x1 = DISPLAY_W - 1;
            set_window((uint16_t)x, (uint16_t)screen_y,
                       (uint16_t)screen_x1, (uint16_t)screen_y);
            write_pixels(row_buf, row_bytes);
        }
    }
}

void display_print(const display_text_ctx_t *ctx, int x, int y, const char *str)
{
    const uint8_t (*font)[8] =
        (ctx->font == DISPLAY_FONT_SANS) ? s_font8x8_sans : s_font8x8;
    int cx = x;
    while (*str) {
        draw_char_font(cx, y, *str, ctx->fg, ctx->bg, ctx->scale, font);
        cx += DISPLAY_FONT_W * ctx->scale;
        str++;
    }
}

void display_draw_bitmap(int x, int y, int w, int h, const uint16_t *pixels)
{
    if (w <= 0 || h <= 0 || !pixels) return;
    if (x < 0 || y < 0 || x + w > DISPLAY_W || y + h > DISPLAY_H) return;

    /* Set the address window once; ILI9341 auto-advances after each row. */
    set_window((uint16_t)x, (uint16_t)y,
               (uint16_t)(x + w - 1), (uint16_t)(y + h - 1));

    /* The .bin pixel buffer stores each pixel as a little-endian uint16_t
     * (native host order on ESP32), so pixels[col] yields the correct
     * RGB565 value.  pack_pixel converts each to big-endian wire order
     * (high byte first) as the ILI9341 requires. */
    uint8_t row_buf[DISPLAY_W * 2];
    for (int row = 0; row < h; row++) {
        const uint16_t *src = pixels + row * w;
        for (int col = 0; col < w; col++) {
            pack_pixel(&row_buf[col * 2], src[col]);
        }
        write_pixels(row_buf, w * 2);
    }
}

void display_draw_row_raw(int x, int y, int w, const uint16_t *pixels)
{
    set_window((uint16_t)x, (uint16_t)y,
               (uint16_t)(x + w - 1), (uint16_t)y);
    spi_transaction_t t = {
        .length    = (size_t)w * 16,
        .tx_buffer = pixels,
        .user      = (void *)1,
    };
    ESP_ERROR_CHECK(spi_device_polling_transmit(s_spi, &t));
}

bool display_draw_qr(int cx, int cy, const char *text,
                     int module_px, uint16_t fg, uint16_t bg)
{
    /* QR buffer: worst-case version 10 (57×57 = 3249 bits = 407 bytes). */
    static uint8_t qr_buf[QR_BUFFER_LEN_MAX];
    int qr_size = 0;

    if (!qr_encode(text, qr_buf, &qr_size)) {
        ESP_LOGE("display", "QR encode failed for: %s", text);
        return false;
    }

    /* QR spec requires a 4-module quiet zone on every side. */
    const int QUIET = 4;
    int qz_px     = QUIET * module_px;
    int total_px  = (qr_size + 2 * QUIET) * module_px;

    int x0 = cx - total_px / 2;   /* top-left corner of quiet zone */
    int y0 = cy - total_px / 2;

    static uint8_t row_buf[DISPLAY_W * 2];
    uint8_t bg_hi = (uint8_t)(bg >> 8);
    uint8_t bg_lo = (uint8_t)(bg & 0xFF);

    /* Clipped screen x-range (same for every row) */
    int sx0    = (x0 < 0) ? 0 : x0;
    int sx1    = (x0 + total_px - 1 < DISPLAY_W) ? x0 + total_px - 1 : DISPLAY_W - 1;
    int skip   = (x0 < 0) ? (-x0 * 2) : 0;
    int nbytes = (sx1 - sx0 + 1) * 2;

    /* Build a solid-background row (used for quiet-zone rows) */
    int full_px = (total_px <= DISPLAY_W) ? total_px : DISPLAY_W;
    for (int i = 0; i < full_px * 2;) {
        row_buf[i++] = bg_hi;
        row_buf[i++] = bg_lo;
    }

    /* Send a pre-built row to one screen scanline */
#define SEND_ROW(sy)  do {                                          \
        int _sy = (sy);                                             \
        if (_sy >= 0 && _sy < DISPLAY_H && nbytes > 0) {           \
            set_window((uint16_t)sx0, (uint16_t)_sy,               \
                       (uint16_t)sx1, (uint16_t)_sy);              \
            write_pixels(row_buf + skip, nbytes);                  \
        }                                                           \
    } while (0)

    /* Top quiet zone */
    for (int py = 0; py < qz_px; py++) {
        SEND_ROW(y0 + py);
    }

    /* Data rows with left/right quiet margins */
    int data_y0 = y0 + qz_px;
    for (int row = 0; row < qr_size; row++) {
        int bi = 0;
        /* Left quiet zone */
        for (int i = 0; i < qz_px; i++) {
            row_buf[bi++] = bg_hi;
            row_buf[bi++] = bg_lo;
        }
        /* QR symbol modules */
        for (int col = 0; col < qr_size; col++) {
            bool dark      = qr_get_module(qr_buf, qr_size, col, row);
            uint16_t color = dark ? fg : bg;
            uint8_t hi     = (uint8_t)(color >> 8);
            uint8_t lo     = (uint8_t)(color & 0xFF);
            for (int p = 0; p < module_px; p++) {
                if (bi / 2 >= DISPLAY_W) break;
                row_buf[bi++] = hi;
                row_buf[bi++] = lo;
            }
        }
        /* Right quiet zone */
        for (int i = 0; i < qz_px && bi / 2 < DISPLAY_W; i++) {
            row_buf[bi++] = bg_hi;
            row_buf[bi++] = bg_lo;
        }

        /* Repeat this row module_px scanlines vertically */
        for (int py = 0; py < module_px; py++) {
            SEND_ROW(data_y0 + row * module_px + py);
        }
    }

    /* Bottom quiet zone — rebuild bg row (data rows overwrote it) */
    for (int i = 0; i < full_px * 2;) {
        row_buf[i++] = bg_hi;
        row_buf[i++] = bg_lo;
    }
    int bot_y0 = data_y0 + qr_size * module_px;
    for (int py = 0; py < qz_px; py++) {
        SEND_ROW(bot_y0 + py);
    }

#undef SEND_ROW
    return true;
}
